## kernel/arch/flux/Kconfig
```kconfig
# SPDX-License-Identifier: GPL-2.0
config FLUX
	def_bool y
	depends on !COMPAT && !USER_RETURN_NOTIFIER
	select ARCH_SUPPORTS_ATOMIC_RMW
	select ARCH_SUPPORTS_PER_VMA_LOCK if FLUX_LINUX66_COMPAT
	select ARCH_USE_QUEUED_RWLOCKS
	select ARCH_USE_QUEUED_SPINLOCKS
	select ARCH_WANTS_NO_INSTR
	select ARCH_WANT_DEFAULT_TOPDOWN_MMAP_LAYOUT if MMU
	select ARCH_WANT_FRAME_POINTERS
	select ARCH_WANT_IRQS_OFF_ACTIVATE_MM
	select BUG
	select DEVTMPFS
	select FLAT_NODE_MEM_MAP
	select LOCK_MM_AND_FIND_VMA 	if MMU
	select MODULES_USE_ELF_RELA if MODULES
	select GENERIC_CLOCKEVENTS
	select GENERIC_CLOCKEVENTS_BROADCAST
	select GENERIC_CPU_DEVICES 		if !SMP
	select GENERIC_ENTRY
	select GENERIC_IRQ_SHOW
	select GENERIC_PENDING_IRQ		if SMP
	select GENERIC_SMP_IDLE_THREAD
	select GENERIC_STRNCPY_FROM_USER
	select GENERIC_STRNLEN_USER
	select GENERIC_GETTIMEOFDAY
	select HAS_DMA
	select HAVE_ARCH_KASAN
	select HAVE_ARCH_MMAP_RND_BITS	if MMU
	select HAVE_ARCH_SECCOMP_FILTER if FLUX_LINUX66_COMPAT
	select HAVE_MEMBLOCK
	select HAVE_REGS_AND_STACK_ACCESS_API
	select HAVE_PERF_EVENTS if FLUX_LINUX66_COMPAT
	select HAVE_ARCH_TRANSPARENT_HUGEPAGE if MMU
	select HAVE_GENERIC_VDSO
	select GENERIC_VDSO_TIME_NS if FLUX_LINUX66_COMPAT
	select GENERIC_TIME_VSYSCALL
	select HAVE_RSEQ
	select HAVE_ARCH_USERFAULTFD_WP if USERFAULTFD
	select HAVE_ARCH_USERFAULTFD_MINOR if USERFAULTFD
	select HAVE_SETUP_PER_CPU_AREA
	select HAVE_UID16 if FLUX_LINUX66_COMPAT
	select HIGH_RES_TIMERS
	select MMU_GATHER_MERGE_VMAS 	if MMU
	select ARCH_SUPPORTS_HUGETLBFS	if MMU
	select ARCH_WANT_GENERAL_HUGETLB	if MMU
	select ARCH_SUPPORTS_MEMORY_FAILURE if MMU
	select NEED_PER_CPU_EMBED_FIRST_CHUNK
	select THREAD_INFO_IN_TASK
	select TRACING

config ARCH_HAS_PROC_MAPS
	def_bool y

menu "Flux configuration"

config FLUX_STATIC_HUGETLB_SHARE
	bool "Use shared hugetlb PMDs for static Flux memory"
	depends on !NUMA && !FLUX_MPK && !FLUX_FNET && !FLUX_SPDK
	default n
	help
	  Experimental native host hugetlb page-table sharing. Static memory
	  (DMA plus normal memory minus the elastic pool) must be a multiple
	  of 1 GiB. Requires a preallocated host 2 MiB hugepage pool. Allocation
	  failure aborts boot; there is no silent base-page fallback. Elastic
	  memory retains its separate reclaimable base-page backing.

config FLUX_HOST_FAULT_REPAIR
	bool "Resolve fork-child read faults in the host with fault-around"
	default n
	help
	  Bind the software page-table root and readable private-anonymous VMA
	  ranges while constructing a fork child. A compatible host module can
	  resolve read faults and project a bounded batch of neighboring pages
	  without SIGSEGV or per-page ioctl round trips. Invalidation retires
	  affected ranges before guest page/table reuse. Writes, executable or
	  shared mappings, and failed registration retain the normal fault path.
	  The module must enable fork_fault_repair separately.

config FLUX_FAULT_STATS
	bool "Collect Flux fault bridge diagnostics"
	depends on PROC_FS
	default n
	help
	  Expose cumulative fault-entry, alias-repair attempt and MM-resolution
	  counters in /proc/flux_fault_stats. Counting is disabled at boot and
	  can be enabled by an administrator with "enable 1". This diagnostic
	  option adds overhead when enabled; leave it off for timing runs.

config FLUX_FORK_STATS
	bool "Collect Flux fork phase elapsed-time diagnostics"
	depends on PROC_FS
	default n
	help
	  Expose cumulative count and nanoseconds per fork phase through
	  /proc/flux_fork_stats. Disabled at boot; an administrator can enable
	  observations with "enable 1". These are inclusive elapsed times,
	  not exclusive CPU costs. Build without this option for a baseline.

config FLUX_LINUX66_COMPAT
	bool "Enable the Linux 6.6 compatibility profile"
	default n
	help
	  Enable the architecture capabilities used by the dedicated
	  linux66_compat_defconfig. Leave this disabled for the original Flux
	  configuration so compatibility-only selections do not change its
	  established behavior.

config 64BIT
	bool "64-bit kernel"
	default y

config X86_64
	def_bool y
	depends on 64BIT

config X86_UMIP
	bool "Expose host x86 UMIP capability"
	depends on X86_64 && FLUX_LINUX66_COMPAT
	help
	  Flux user instructions execute on the x86 host. Enable this only when
	  the host kernel enforces User-Mode Instruction Prevention so userspace
	  and capability probes observe the effective execution environment.

config FLUX_UINTR
	def_bool y
	depends on X86_64

config FLUX_MPK
	bool "Isolate the Flux kernel from applications with MPK"
	default n
	depends on X86_64
	help
	  Put the Flux kernel and host runtime in a protection-key domain and
	  switch PKRU at the Flux syscall gates. The loader rejects application
	  code containing WRPKRU or XRSTOR and the host module enforces W^X. This
	  option is independent of the Linux 6.6 compatibility profile. Enable it
	  only with a host module and runtime built for MPK isolation.

config OUTPUT_FORMAT
       string "Output format"
       default ""

config ARCH_DMA_ADDR_T_64BIT
	def_bool 64BIT

config ARCH_SPARSEMEM_ENABLE
	def_bool y
	select SPARSEMEM

config PHYS_ADDR_T_64BIT
	def_bool 64BIT

config MMU
	def_bool 64BIT

config ARCH_MMAP_RND_BITS_MIN
	depends on MMU
	default 22

config ARCH_MMAP_RND_BITS_MAX
	depends on MMU
	default 22

config ARCH_MMAP_RND_BITS_DEFAULT
	depends on MMU
	default 22

config PGTABLE_LEVELS
	int
	depends on MMU
	default 4

config COREDUMP
	def_bool FLUX_LINUX66_COMPAT

config BIG_ENDIAN
	def_bool n

config CPU_BIG_ENDIAN
	def_bool BIG_ENDIAN

config GENERIC_CSUM
	def_bool y

config NO_IOPORT_MAP
	def_bool y

config CONSOLE_LOGLEVEL_QUIET
	int "quiet console loglevel (1-15)"
	range 1 15
	default "4"
	help
	  loglevel to use when "quiet" is passed on the kernel commandline.

	  When "quiet" is passed on the kernel commandline this loglevel
	  will be used as the loglevel. IOW passing "quiet" will be the
	  equivalent of passing "loglevel=<CONSOLE_LOGLEVEL_QUIET>"

config PCI
	bool "PCI support"
	select GENERIC_PCI_IOMAP
	default n

config STACKTRACE_SUPPORT
       def_bool y

if KASAN
config KASAN_SHADOW_OFFSET
	hex "KASAN shadow offset"
	default "0"

config KASAN_SHADOW_SIZE
       hex "KASAN shadow size"
       default "0"
endif

config BUILTIN_CMDLINE
	string "Built-in kernel command string"
	default ""
	help
	  Enter arguments here that should be compiled into the kernel
	  image and used at boot time. The command line provided to
	  flux_start_kernel is appended to this string to form the full
	  command line.

config FLUX_SMP
	bool "Build Flux with SMP support"
	default n
	select GENERIC_SMP_IDLE_THREAD
	help
	  This enables support for systems with more than one CPU. If you have
	  a system with only one CPU, say N. If you have a system with more
	  than one CPU, say Y.

	  If you say N here, the kernel will run on uni- and multiprocessor
	  machines, but will use only one CPU of a multiprocessor machine. If
	  you say Y here, the kernel will run on many, but not all,
	  uniprocessor machines. On a uniprocessor machine, the kernel
	  will run faster if you say N here.

config SMP
	bool
	default FLUX_SMP

config FLUX_MAX_CPUS
	int "Maximum number of CPUs supported by Flux"
	range 1 64 if SMP
	range 1 1 if !SMP
	default 1
	help
	  The shared MPK return area provides 64 independent slots for each
	  return class. Keep this limit synchronized with
	  FLUX_MPK_RETURN_SLOT_CAPACITY.

if SMP
config NR_CPUS
	int
	default FLUX_MAX_CPUS
	help
	  This allows you to specify the maximum number of CPUs which this
	  kernel will support. 

	  This option is available only if SMP is enabled.
endif

config ARCH_FORCE_MAX_ORDER
	int "Maximum order of the buddy allocator"
	default 16

choice
	prompt "Default scheduler policy for Flux user tasks"
	default FLUX_SCHED_NORMAL
	help
	  Select the scheduler policy assigned to the initial Flux user task.
	  Child tasks inherit this policy unless changed later.

config FLUX_SCHED_NORMAL
	bool "SCHED_NORMAL"
	help
	  Run Flux user tasks in the fair scheduling class.

config FLUX_SCHED_FIFO
	bool "SCHED_FIFO"
	help
	  Run Flux user tasks in the real-time FIFO scheduling class.

config FLUX_SCHED_RR
	bool "SCHED_RR"
	help
	  Run Flux user tasks in the real-time round-robin scheduling class.

endchoice

config NUMA
	bool "NUMA Memory Allocation and Scheduler Support"
	depends on SMP
	depends on X86_64
	select HAVE_SETUP_PER_CPU_AREA
	select MMU
	select NEED_PER_CPU_EMBED_FIRST_CHUNK
	select NEED_PER_CPU_PAGE_FIRST_CHUNK
	select USE_PERCPU_NUMA_NODE_ID
	select GENERIC_ARCH_TOPOLOGY
	help
	  Enable NUMA (Non-Uniform Memory Access) support.

	  The kernel will try to allocate memory used by a CPU on the
	  local memory controller of the CPU and add some more
	  NUMA awareness to the kernel.

config NODES_SHIFT
	int "Maximum NUMA nodes (as a power of 2)"
	default 4
	depends on NUMA
	help
	  This option specifies the maximum number of NUMA nodes
	  supported by the kernel.

config FLUX_NUMA_EMULATION
	bool "Expose a two-node virtual NUMA topology"
	depends on NUMA && FLUX_LINUX66_COMPAT
	default n
	help
	  Split the Flux memory map into two virtual NUMA nodes when no
	  explicit numa= topology was supplied and the boot command line contains
	  flux_numa_emulation=on. Linux's generic memory-policy implementation
	  remains authoritative; this option does not fabricate syscall return
	  values. Leave the boot option unset when host-backed NUMA locality is
	  required.

if X86_64

config AS_AVX512
	def_bool $(as-instr,vpmovm2b %k1$(comma)%zmm5)
	help
	  Supported by binutils >= 2.25 and LLVM integrated assembler

source "arch/flux/kernel/x86/crypto/Kconfig"

endif

choice
	prompt "Timer frequency"
	default HZ_100

config HZ_100
	bool "100 Hz"

config HZ_200
	bool "200 Hz"

config HZ_250
	bool "250 Hz"

config HZ_300
	bool "300 Hz"

config HZ_500
	bool "500 Hz"

config HZ_1000
	bool "1000 Hz"

config HZ_10000
	bool "10000 Hz"

endchoice

config HZ
	int
	default 100 if HZ_100
	default 200 if HZ_200
	default 250 if HZ_250
	default 300 if HZ_300
	default 500 if HZ_500
	default 1000 if HZ_1000
	default 10000 if HZ_10000
	default 1000

config FLUX_RUNC
	bool "Build Flux OCI/runc userspace support"
	default y
	help
	  Build the Flux userspace OCI/runc integration, including the
	  flux-runc binary and OCI bundle parsing/rootfs setup helpers used
	  by the Flux launcher.

config FLUX_SPDK
	bool "SPDK support"
	select BLOCK
	default n
	help
	  Access block devices via SPDK.

config BLK_DEV_SPDK
	bool
	default FLUX_SPDK

config FLUX_FNET
	bool "Fast network support"
	default n
	select ZONE_DMA
	help
	  Access network devices through external flux_iokd.

config NET_DEV_FNET
	bool
	default FLUX_FNET

config FLUX_FNET_RX_SCHED_IDLE
	bool "Run the FNet RX threads with SCHED_IDLE"
	depends on FLUX_FNET
	default y
	help
	  Run the per-CPU FNet receive threads using the SCHED_IDLE policy.
	  Disable this option to retain the default SCHED_NORMAL policy when
	  measuring the idle-thread scheduling optimization independently. This
	  changes scheduling priority only; receive processing is unchanged.

config FLUX_FAST_NET
	bool "Fast network layer (replace default socket)"
	depends on FLUX_FNET
	default n
	help
	  Use fast network layer for better performance. Requires FLUX_FNET.

menu "FastNet optimization options"
	depends on FLUX_FAST_NET

config FLUX_FAST_NET_EPOLL
	bool "Poll FastNet before epoll waits"
	default y
	help
	  Drain the current CPU's FastNet receive queue before entering the
	  generic epoll wait path. Disable this option to measure the epoll
	  integration overhead and benefit independently.

config FLUX_FAST_NET_LOCAL_CACHE
	bool "Use per-CPU FastNet mbuf caches"
	default y
	help
	  Cache recently released RX and TX mbufs on each CPU to avoid slab
	  allocator traffic in the packet path. Disable this option to retain
	  zero-copy networking while measuring allocation without local caches.

endmenu

config X86_TSC
	depends on X86_64
	bool "Use the Time Stamp Counter (TSC) as the system clock"
	default n

config GENERIC_CALIBRATE_DELAY
	depends on X86_TSC
	def_bool y

config FLUX_CONSOLE_READ_PATH
	bool "Enable flux_console read path"
	default y
	help
	  If this option is enabled then /dev/flux_console0 will support
	  reading console input from the host via a dedicated input thread.

	  If this option is disabled then flux_console still supports the
	  printk and TTY write paths, but no console read path is compiled in.

config FLUX_ELASTIC_MEMORY
	bool "Experimental extent-backed movable page pool"
	depends on PROC_FS && !NUMA && !FLUX_MPK && !DEBUG_PAGEALLOC && !KASAN
	depends on !PAGE_POISONING
	default n
	help
	  Reserve a separate bitmap-allocated pool at boot. Capacity changes
	  revoke and release whole empty host extents without memory hotplug.
	  Order-0 movable allocations opt in through /proc/flux_elastic.
	  This experimental pool has separate accounting from buddy memory.

config FLUX_ELASTIC_MIGRATION
	bool "Evacuate live elastic pages and enable pressure control"
	depends on FLUX_ELASTIC_MEMORY && MIGRATION
	default n
	help
	  Add explicit live-page draining and an opt-in host-pressure policy.
	  Only ordinary order-0 LRU pages can migrate; unsupported or pinned
	  pages leave the extent resident and return busy. Destinations use the
	  normal buddy allocator, outside the elastic pool. DMA remains static.

config FLUX_ELASTIC_POOL_MB
	int "Elastic pool capacity in MiB (multiple of 2)"
	depends on FLUX_ELASTIC_MEMORY
	range 2 512
	default 32

menu "Flux Debug Options"
	depends on DEBUG_KERNEL

	config X86_DEBUG_FPU
		bool "Debug the x86 FPU code"
		default n
		help
		  If this option is enabled then there will be extra sanity
		  checks and (boot time) debug printouts added to the kernel.
		  This debugging adds some small amount of runtime overhead
		  to the kernel.

		  If unsure, say N.

	config DEBUG_FNET
		bool "Debug fnet net device"
		default n

	config STAT_FNET
		bool "Collect fnet net device statistics"
		default n

	config X86_DEBUG_SYSCALL
		bool "Debug x86 syscall handling"
		default n
		help
		  If this option is enabled then there will be extra sanity
		  checks and debug printouts added to the syscall handling
		  code. This debugging adds some small amount of runtime
		  overhead to the kernel.

		  If unsure, say N.

	config DEBUG_CONS_INPUT
		bool "Debug console input path"
		default n
		help
		  If this option is enabled then the console input thread
		  will log when input bytes are read from the host.

		  If unsure, say N.

	config DEBUG_PROC_SWITCH
		bool "Debug process switch"
		default n
		help
		  If this option is enabled then the process switch will log
		  the process key being switched from and to.

		  If unsure, say N.

endmenu

endmenu
```
